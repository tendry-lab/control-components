## components/ocs_core/Kconfig
```kconfig
menu "OCS Core Configuration"
    config OCS_CORE_FW_VERSION
        string "Firmware Version"
        default "0.0.0"
        help
            Firmware version in SemVer format.

    config OCS_CORE_FW_NAME
        string "Firmware Name"
        default "firmware"
        help
            Firmware name.

    config OCS_CORE_FW_DESCRIPTION
        string "Firmware Description"
        default "firmware"
        help
            Firmware description.

    config OCS_CORE_PRODUCT_NAME
        string "Product Name"
        default "product"
        help
            Product name.

    config OCS_CORE_COMPANY_UUID
        string "Company UUID"
        default "company"
        help
            Unique company string identifier.
endmenu
```

## projects/sht4x-verifier/main/Kconfig
```kconfig
menu "Senserion SHT4x Sensor Verification"
    config OCS_TOOL_SHT4x_VERIFIER_I2C_MASTER_SDA_GPIO
        int "I2C master SDA GPIO"
        default 21
        help
            I2C master SDA GPIO.

    config OCS_TOOL_SHT4x_VERIFIER_I2C_MASTER_SCL_GPIO
        int "I2C master SCL GPIO"
        default 22
        help
            I2C master SCL GPIO.

    config OCS_TOOL_SHT4x_VERIFIER_POWER_GPIO
        int "Power GPIO"
        default -1
        help
            GPIO pin to enable power for the sensor.
endmenu
```
